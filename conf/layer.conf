## conf/layer.conf
```bitbake
BBPATH .= ":${LAYERDIR}"

BBFILES += " ${LAYERDIR}/recipes-*/*/*.bb ${LAYERDIR}/recipes-*/*/*.bbappend"

BBFILE_COLLECTIONS += "network-configurator"
BBFILE_PATTERN_network-configurator = "^${LAYERDIR}/"
BBFILE_PRIORITY_network-configurator = "50"
LAYERVERSION_network-configurator = "1"
LAYERSERIES_COMPAT_network-configurator = "scarthgap"
```
